## conf/machine/sf8008m.conf
```bitbake
#@TYPE: Machine
#@NAME: sf8008m
#@DESCRIPTION: Machine configuration for the sf8008m

EXTRA_OECONF_append_pn-enigma2 = "--with-lcddev=/dev/null --with-alphablendingacceleration=always --with-blitaccelerationthreshold=250  --with-fillaccelerationthreshold=190000"

MACHINE_FEATURES += " textlcd 7segment blindscan dvb-c hisil mali transcoding emmc"
OPENPLI_FEATURES += " qtplugins kodi openhbbtvbrowser"
DISTRO_FEATURES_remove = "x11 wayland"

CHIPSET = "Hi3798Mv200"

SOC_FAMILY = "hisi3798mv200"

require conf/machine/include/octagon-hisi.inc
```

## conf/machine/sfx6008.conf
```bitbake
#@TYPE: Machine
#@NAME: sfx6008
#@DESCRIPTION: Machine configuration for the sfx6008

EXTRA_OECONF_append_pn-enigma2 = "--with-lcddev=/dev/null --with-alphablendingacceleration=always --with-blitaccelerationthreshold=250  --with-fillaccelerationthreshold=190000"

MACHINE_FEATURES += " textlcd 7segment blindscan hisil noopengl"
OPENPLI_FEATURES += " qtplugins"
DISTRO_FEATURES_remove = "x11 directfb"

CHIPSET = "Hi3716Mv430"
SOC_FAMILY = "hisi3716mv430"


MTD_KERNEL = "mtd10"
MTD_ROOTFS = "mtd12"

require conf/machine/include/octagon-hisi-3716mv430.inc
```

## conf/machine/sx88v2.conf
```bitbake
#@TYPE: Machine
#@NAME: sx88v2
#@DESCRIPTION: Machine configuration for the sx88v2

EXTRA_OECONF_append_pn-enigma2 = "--with-lcddev=/dev/null --with-alphablendingacceleration=always --with-blitaccelerationthreshold=250  --with-fillaccelerationthreshold=190000"

MACHINE_FEATURES += " textlcd 7segment blindscan hisil mali transcoding emmc"
OPENPLI_FEATURES += " qtplugins kodi openhbbtvbrowser"
DISTRO_FEATURES_remove = "x11 wayland"

CHIPSET = "Hi3798Mv300"
SOC_FAMILY = "hisi3798mv300"


require conf/machine/include/octagon-hisi-3798mv300.inc

MACHINE_ESSENTIAL_EXTRA_RDEPENDS += "\
    firmware-uwe5621 \
    "
```
